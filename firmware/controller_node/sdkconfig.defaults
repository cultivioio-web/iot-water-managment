## firmware/controller_node/sdkconfig.defaults
```kconfig
# Target
CONFIG_IDF_TARGET="esp32c6"

# Zigbee Coordinator configuration
CONFIG_ZB_ENABLED=y
CONFIG_ZB_ZCZR=y

# IEEE 802.15.4 Radio
CONFIG_IEEE802154_ENABLED=y

# Partition table
CONFIG_PARTITION_TABLE_SINGLE_APP=y

# FreeRTOS
CONFIG_FREERTOS_HZ=100

# Log level
CONFIG_LOG_DEFAULT_LEVEL_INFO=y
CONFIG_LOG_MAXIMUM_LEVEL_DEBUG=y

# NVS
CONFIG_NVS_ENCRYPTION=n

# Stack size
CONFIG_ESP_MAIN_TASK_STACK_SIZE=4096
```

## firmware/controller_node/sdkconfig.defaults.esp32h2
```kconfig
# ESP32-H2 Specific Configuration - Controller Node

# Zigbee Coordinator configuration
CONFIG_ZB_ENABLED=y
CONFIG_ZB_ZCZR=y

# IEEE 802.15.4 Radio
CONFIG_IEEE802154_ENABLED=y

# Bluetooth
CONFIG_BT_ENABLED=y
CONFIG_BT_BLUEDROID_ENABLED=y
CONFIG_BT_BLE_42_FEATURES_SUPPORTED=y

# Partition table (need more space for BLE + Zigbee)
CONFIG_PARTITION_TABLE_CUSTOM=y
CONFIG_PARTITION_TABLE_CUSTOM_FILENAME="partitions.csv"

# FreeRTOS
CONFIG_FREERTOS_HZ=100

# Log level
CONFIG_LOG_DEFAULT_LEVEL_INFO=y
CONFIG_LOG_MAXIMUM_LEVEL_DEBUG=y

# NVS
CONFIG_NVS_ENCRYPTION=n

# Stack size
CONFIG_ESP_MAIN_TASK_STACK_SIZE=4096

# ESP32-H2 specific
CONFIG_RTC_CLK_SRC_INT_RC=y
```

## firmware/router_node/sdkconfig.defaults
```kconfig
# Cultivio AquaSense - Router Node SDK Configuration

# Zigbee configuration
CONFIG_ZB_ENABLED=y
CONFIG_ZB_ZCZR=y

# Router role for mesh networking
CONFIG_ESP_ZIGBEE_COORDINATOR_ONLY=n

# IEEE 802.15.4 Radio
CONFIG_IEEE802154_ENABLED=y

# Partition table
CONFIG_PARTITION_TABLE_CUSTOM=y
CONFIG_PARTITION_TABLE_CUSTOM_FILENAME="partitions.csv"

# Log level
CONFIG_LOG_DEFAULT_LEVEL_INFO=y

# FreeRTOS
CONFIG_FREERTOS_HZ=1000
```

## firmware/router_node/sdkconfig.defaults.esp32h2
```kconfig
# ESP32-H2 specific configuration for Router Node

CONFIG_IDF_TARGET="esp32h2"

# IEEE 802.15.4
CONFIG_IEEE802154_ENABLED=y

# Zigbee
CONFIG_ZB_ENABLED=y
CONFIG_ZB_ZCZR=y
```

## firmware/test_esp32/sdkconfig.defaults
```kconfig
# Cultivio AquaSense - Test Configuration for ESP32-WROOM
# For testing BLE provisioning and controller simulation

# Target: ESP32 (WROOM)
CONFIG_IDF_TARGET="esp32"

# Bluetooth Configuration
CONFIG_BT_ENABLED=y
CONFIG_BT_BLUEDROID_ENABLED=y
CONFIG_BT_CLASSIC_ENABLED=n
CONFIG_BT_BLE_ENABLED=y
CONFIG_BT_GATTS_ENABLE=y
CONFIG_BT_GATTC_ENABLE=n
CONFIG_BT_BLE_42_FEATURES_SUPPORTED=y
CONFIG_BT_BTU_TASK_STACK_SIZE=4096

# BLE Configuration
CONFIG_BT_CTRL_MODE_EFF=1
CONFIG_BT_CTRL_BLE_MAX_ACT=6
CONFIG_BT_CTRL_BLE_MAX_ACT_EFF=6
CONFIG_BT_CTRL_BLE_STATIC_ACL_TX_BUF_NB=0
CONFIG_BT_CTRL_PINNED_TO_CORE=0
CONFIG_BT_CTRL_HCI_MODE_VHCI=y

# NVS Configuration
CONFIG_NVS_ENCRYPTION=n

# Log Level
CONFIG_LOG_DEFAULT_LEVEL_INFO=y
CONFIG_LOG_MAXIMUM_LEVEL_DEBUG=y

# FreeRTOS
CONFIG_FREERTOS_HZ=1000

# Partition Table
CONFIG_PARTITION_TABLE_CUSTOM=y
CONFIG_PARTITION_TABLE_CUSTOM_FILENAME="partitions.csv"

# Stack sizes
CONFIG_ESP_MAIN_TASK_STACK_SIZE=4096
CONFIG_ESP_SYSTEM_EVENT_TASK_STACK_SIZE=2304

# Power Management (disable for testing)
CONFIG_PM_ENABLE=n

# Watchdog
CONFIG_ESP_TASK_WDT_TIMEOUT_S=10
```

## firmware/unified/sdkconfig.defaults
```kconfig
# Cultivio AquaSense - Unified Firmware Configuration
# Supports Sensor, Controller, and Router roles

# Zigbee configuration
CONFIG_ZB_ENABLED=y
CONFIG_ZB_ZCZR=y

# Support all device types (Coordinator, Router, End Device)
# The actual role is determined at runtime based on provisioning

# Bluetooth configuration (for BLE provisioning and status)
CONFIG_BT_ENABLED=y
CONFIG_BT_BLUEDROID_ENABLED=y
CONFIG_BT_GATTS_ENABLE=y
CONFIG_BT_BLE_42_FEATURES_SUPPORTED=y

# Partition table
CONFIG_PARTITION_TABLE_CUSTOM=y
CONFIG_PARTITION_TABLE_CUSTOM_FILENAME="partitions.csv"

# NVS for storing device configuration
CONFIG_NVS_ENCRYPTION=n

# Stack sizes
CONFIG_ESP_MAIN_TASK_STACK_SIZE=4096
CONFIG_FREERTOS_TIMER_TASK_STACK_DEPTH=3072

# Logging
CONFIG_LOG_DEFAULT_LEVEL_INFO=y

# IEEE 802.15.4 Radio
CONFIG_IEEE802154_ENABLED=y

# Optimize for size
CONFIG_COMPILER_OPTIMIZATION_SIZE=y
```

## firmware/unified/sdkconfig.defaults.esp32h2
```kconfig
# ESP32-H2 Specific Configuration
# Cultivio AquaSense Unified Firmware

# Target
CONFIG_IDF_TARGET="esp32h2"

# Bluetooth LE for ESP32-H2
CONFIG_BT_ENABLED=y
CONFIG_BT_BLUEDROID_ENABLED=y
CONFIG_BT_GATTS_ENABLE=y
CONFIG_BT_BLE_42_FEATURES_SUPPORTED=y

# IEEE 802.15.4 (Zigbee/Thread)
CONFIG_IEEE802154_ENABLED=y

# Zigbee - Support all device types
CONFIG_ZB_ENABLED=y
CONFIG_ZB_ZCZR=y

# Flash configuration
CONFIG_ESPTOOLPY_FLASHSIZE_4MB=y
CONFIG_ESPTOOLPY_FLASHMODE_QIO=y

# CPU frequency
CONFIG_ESP_DEFAULT_CPU_FREQ_MHZ_96=y
```

## sdkconfig.defaults
```kconfig
#
# Keep Arduino tick frequency requirements satisfied
#
CONFIG_FREERTOS_HZ=1000
```

## sdkconfig.defaults.esp32c6
```kconfig
#
# ESP32-C6 specific configuration (with Zigbee support)
#
CONFIG_FREERTOS_HZ=1000

# Enable Zigbee stack (native 802.15.4 radio)
CONFIG_ZB_ENABLED=y
CONFIG_ZB_ZCZR=y
CONFIG_ZB_RADIO_NATIVE=y

# OpenThread for Thread/Zigbee coexistence
CONFIG_OPENTHREAD_ENABLED=y
```

## sdkconfig.defaults.esp32h2
```kconfig
#
# ESP32-H2 specific configuration (with Zigbee support)
#
CONFIG_FREERTOS_HZ=1000

# Enable Zigbee stack (native 802.15.4 radio)
CONFIG_ZB_ENABLED=y
CONFIG_ZB_ZCZR=y
CONFIG_ZB_RADIO_NATIVE=y

# OpenThread for Thread/Zigbee
CONFIG_OPENTHREAD_ENABLED=y
```
